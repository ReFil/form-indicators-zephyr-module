## Kconfig
```kconfig
menuconfig ZMK_STP_INDICATORS
    bool "STP Specific indicators"
    select LED_STRIP
    select ZMK_LOW_PRIORITY_WORK_QUEUE
    select ZMK_HID_INDICATORS

if ZMK_STP_INDICATORS

# This default value cuts down on tons of excess .conf files, if you're using GPIO, manually disable this
config SPI
    default y

config ZMK_STP_INDICATORS_BEHAVIOR
    bool "Enable the STP indicators behavior"
    default y

config ZMK_STP_INDICATORS_SWITCH_LEDS
    bool "Swap LED0 and LED1"

config ZMK_STP_INDICATORS_COLOR_CAPS
    bool "illuminate caps LED with profile LED color"

config ZMK_STP_INDICATORS_BRT_MAX
    int "RGB underglow maximum brightness in percent"
    range 0 100
    default 100

endif
```

## dts/bindings/behaviors/zmk,behavior-stp-indicators.yaml
```yaml
# Copyright (c) 2024 The ZMK Contributors
# SPDX-License-Identifier: MIT

description: RGB indicators

compatible: "zmk,behavior-stp-indicators"

include: one_param.yaml
```
